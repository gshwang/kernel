## arch/arm/mach-ep93xx/Kconfig
```kconfig
if ARCH_EP93XX

menu "Cirrus EP93xx Implementation Options"

config CRUNCH
	bool "Support for MaverickCrunch"
	help
	  Enable kernel support for MaverickCrunch.

comment "EP93xx Platforms"

config MACH_ADSSPHERE
	bool "Support ADS Sphere"
	help
	  Say 'Y' here if you want your kernel to support the ADS
	  Sphere board.

config MACH_EDB9301
	bool "Support Cirrus Logic EDB9301"
	help
	  Say 'Y' here if you want your kernel to support the Cirrus
	  Logic EDB9301 Evaluation Board.

config MACH_EDB9302
	bool "Support Cirrus Logic EDB9302"
	help
	  Say 'Y' here if you want your kernel to support the Cirrus
	  Logic EDB9302 Evaluation Board.

config MACH_EDB9302A
	bool "Support Cirrus Logic EDB9302A"
	help
	  Say 'Y' here if you want your kernel to support the Cirrus
	  Logic EDB9302A Evaluation Board.

config MACH_EDB9307
	bool "Support Cirrus Logic EDB9307"
	help
	  Say 'Y' here if you want your kernel to support the Cirrus
	  Logic EDB9307 Evaluation Board.

config MACH_EDB9307A
	bool "Support Cirrus Logic EDB9307A"
	help
	  Say 'Y' here if you want your kernel to support the Cirrus
	  Logic EDB9302A Evaluation Board.

config MACH_EDB9312
	bool "Support Cirrus Logic EDB9312"
	help
	  Say 'Y' here if you want your kernel to support the Cirrus
	  Logic EDB9312 Evaluation Board.

config MACH_EDB9315
	bool "Support Cirrus Logic EDB9315"
	help
	  Say 'Y' here if you want your kernel to support the Cirrus
	  Logic EDB9315 Evaluation Board.

config MACH_EDB9315A
	bool "Support Cirrus Logic EDB9315A"
	help
	  Say 'Y' here if you want your kernel to support the Cirrus
	  Logic EDB9315A Evaluation Board.

config MACH_GESBC9312
	bool "Support Glomation GESBC-9312-sx"
	help
	  Say 'Y' here if you want your kernel to support the Glomation
	  GESBC-9312-sx board.

config MACH_MICRO9
        bool
        default n

config MACH_MICRO9H
       bool "Support Contec Hypercontrol Micro9-H"
       select MACH_MICRO9
       help
         Say 'Y' here if you want your kernel to support the
         Contec Hypercontrol Micro9-H board.

config MACH_MICRO9M
       bool "Support Contec Hypercontrol Micro9-M"
       select MACH_MICRO9
       help
         Say 'Y' here if you want your kernel to support the
         Contec Hypercontrol Micro9-M board.

config MACH_MICRO9L
       bool "Support Contec Hypercontrol Micro9-L"
       select MACH_MICRO9
       help
         Say 'Y' here if you want your kernel to support the
         Contec Hypercontrol Micro9-L board.

config MACH_TS72XX
	bool "Support Technologic Systems TS-72xx SBC"
	help
	  Say 'Y' here if you want your kernel to support the
	  Technologic Systems TS-72xx board.

config FALINUX_EP9312
    bool "FALINUX EP9312 Board"
    default y

config MACH_EZ_EP9312
    bool "EZ-EP9312"
    depends on FALINUX_EP9312
    help
        Say Y here if you are using the FALINUX EZ-EP9312 Board.
        <www.falinux.com>

config MACH_ESP_MMI
    bool "ESP-MMI"
    depends on FALINUX_EP9312
    help
        Say Y here if you are using the FALINUX ESP-MMi Board.
        <www.falinux.com>

endmenu

endif
```

## sound/arm/Kconfig
```kconfig
# ALSA ARM drivers

menu "ALSA ARM devices"
	depends on SND!=n && ARM

config SND_SA11XX_UDA1341
	tristate "SA11xx UDA1341TS driver (iPaq H3600)"
	depends on ARCH_SA1100 && SND && L3
	select SND_PCM
	help
	  Say Y here if you have a Compaq iPaq H3x00 handheld computer
	  and want to use its Philips UDA 1341 audio chip.

	  To compile this driver as a module, choose M here: the module
	  will be called snd-sa11xx-uda1341.

config SND_EP93XX_IIS
	tristate "EP93xx ALSA iis audio driver"
	depends on ARCH_EP93XX && SND
	select SND_PCM
	help
	  Say Y or M if you have a EP93xx board and want to use iis audio and
	  to use CS4228A and CS4271.

config CODEC_CS4228A
	tristate "Cirrus cs4228a 6-channels sound"
	depends on MACH_EDB9312 || MACH_EDB9315 || MACH_EDB9307
	help
	  This module drives the Cirrus Logic device CS4281A when wired
	  as native sound drivers with I2S codecs. It olny work on
	  EDB9307/12/15 with disable CS4202 driver.

config CODEC_CS4271
	tristate "Cirrus cs4271 2-channels sound"
	depends on (MACH_EDB9301 || MACH_EDB9302 || MACH_EDB9315A || MACH_EDB9307A || MACH_EDB9302A)
	help
	  This module drives the Cirrus Logic device CS4271 when wired
	  as native sound drivers with I2S codecs. It olny work on
	  EDB9301/02/15A with disable CS4202 driver.

config SND_EP93XX_AC97
	tristate "AC97 driver for the Cirrus EP93xx chip"
	depends on ARCH_EP93XX && SND
	select SND_EP93XX_PCM
	select SND_AC97_CODEC
	help
	  Say Y or M if you want to support any AC97 codec attached to
	  the EP93xx AC97 interface.

config SND_EP93XX_PCM
	tristate
	select SND_PCM
	help
	  Generic PCM module for EP93xx
				      
config SND_ARMAACI
	tristate "ARM PrimeCell PL041 AC Link support"
	depends on SND && ARM_AMBA
	select SND_PCM
	select SND_AC97_CODEC

config SND_PXA2XX_PCM
	tristate
	select SND_PCM

config SND_PXA2XX_AC97
	tristate "AC97 driver for the Intel PXA2xx chip"
	depends on ARCH_PXA && SND
	select SND_PXA2XX_PCM
	select SND_AC97_CODEC
	help
	  Say Y or M if you want to support any AC97 codec attached to
	  the PXA2xx AC97 interface.

endmenu
```
